## boards/nxp/frdm-imx8mp/nuttx-config/Kconfig
```kconfig
#
# NXP FRDM-IMX8MPLUS, Cortex-M7 (PX4 board nxp/frdm-imx8mp)
# Chip options: NuttX arch/arm/src/mx8mp/Kconfig (in-tree since NuttX 12.x).
#

config BOARD_FRDM_IMX8MP_WDOG3
	bool "Arm WDOG3 (M7-only watchdog)"
	default y
	---help---
		Arm WDOG3 in board_app_initialize() and feed it from the high-priority work queue.
		On timeout it resets only the M7 (SRC_M7RCR.WDOG3_RST_OPTION = 0); Linux on the
		Cortex-A53s keeps running.

config BOARD_FRDM_IMX8MP_WDOG3_TIMEOUT_MS
	int "WDOG3 timeout (ms)"
	default 2000
	range 500 128000
	depends on BOARD_FRDM_IMX8MP_WDOG3

config BOARD_FRDM_IMX8MP_RPMSG_TTY
	bool "RPMsg serial port to the Cortex-A53 (Linux imx_rpmsg_tty)"
	default y
	depends on MX8MP_RPMSG
	select SERIAL_RXDMA
	select SERIAL_TXDMA
	---help---
		Raw RPMsg serial device compatible with NXP's Linux imx_rpmsg_tty
		driver (name service "rpmsg-virtual-tty-channel" -> /dev/ttyRPMSG<n>
		on the A53).  Registered on the M7 as BOARD_FRDM_IMX8MP_RPMSG_TTY_PATH.

if BOARD_FRDM_IMX8MP_RPMSG_TTY

config BOARD_FRDM_IMX8MP_RPMSG_TTY_PATH
	string "NuttX device path"
	default "/dev/ttyRPMSG0"

config BOARD_FRDM_IMX8MP_RPMSG_TTY_EPT
	string "RPMsg endpoint / name-service name"
	default "rpmsg-virtual-tty-channel"

config BOARD_FRDM_IMX8MP_RPMSG_TTY_BUFSIZE
	int "RX/TX ring buffer size"
	default 4096

endif
```

## boards/nxp/frdm-imx8mp/nuttx-config/nsh/defconfig
```kconfig
#
# NXP FRDM-IMX8MPLUS Cortex-M7, PX4 (nxp_frdm-imx8mp_default)
#
# This file is a reduced defconfig: only non-default values. Regenerate with
#   make nxp_frdm-imx8mp_default boardguiconfig   (or menuconfig), then savedefconfig.
#
# CONFIG_MMCSD_HAVE_CARDDETECT is not set
# CONFIG_NSH_DISABLE_IFCONFIG is not set
# CONFIG_NSH_DISABLE_PS is not set
CONFIG_ARCH="arm"
CONFIG_ARCH_BOARD_CUSTOM=y
CONFIG_ARCH_BOARD_CUSTOM_DIR="../../../../boards/nxp/frdm-imx8mp/nuttx-config"
CONFIG_ARCH_BOARD_CUSTOM_DIR_RELPATH=y
CONFIG_ARCH_BOARD_CUSTOM_NAME="px4"
CONFIG_ARCH_CHIP="mx8mp"
CONFIG_ARCH_CHIP_MX8MP=y
CONFIG_ARCH_INTERRUPTSTACK=2048
CONFIG_ARCH_STACKDUMP=y
CONFIG_ARMV7M_BASEPRI_WAR=y
CONFIG_ARMV7M_DCACHE=y
CONFIG_ARMV7M_DCACHE_WRITETHROUGH=y
CONFIG_ARMV7M_ICACHE=y
CONFIG_ARMV7M_MEMCPY=y
CONFIG_ARMV7M_USEBASEPRI=y
CONFIG_ARM_MPU=y
CONFIG_ARM_MPU_EARLY_RESET=y
CONFIG_BOARDCTL_RESET=y
CONFIG_BOARD_ASSERT_RESET_VALUE=0
CONFIG_BOARD_EARLY_INITIALIZE=y
CONFIG_BOARD_LOOPSPERMSEC=159972
CONFIG_BOARD_RESET_ON_ASSERT=2
CONFIG_BUILTIN=y
CONFIG_DEBUG_FULLOPT=y
CONFIG_DEBUG_HARDFAULT_ALERT=y
CONFIG_DEBUG_MEMFAULT=y
CONFIG_DEBUG_SYMBOLS=y
CONFIG_DEBUG_TCBINFO=y
CONFIG_DEV_FIFO_SIZE=0
CONFIG_DEV_PIPE_MAXSIZE=1024
CONFIG_DEV_PIPE_SIZE=70
CONFIG_DEV_RPMSG=y
CONFIG_DEV_SIMPLE_ADDRENV=y
CONFIG_ETC_CROMFS=y
CONFIG_ETC_ROMFS=y
CONFIG_ETC_ROMFSSECTSIZE=128
CONFIG_FDCLONE_STDIO=y
CONFIG_FILE_STREAM=y
CONFIG_FS_BINFS=y
CONFIG_FS_CROMFS=y
CONFIG_FS_LARGEFILE=y
CONFIG_FS_PROCFS=y
CONFIG_FS_PROCFS_INCLUDE_PROGMEM=y
CONFIG_FS_PROCFS_MAX_TASKS=64
CONFIG_FS_PROCFS_REGISTER=y
CONFIG_FS_ROMFS=y
CONFIG_FS_TMPFS=y
CONFIG_GRAN=y
CONFIG_GRAN_INTR=y
CONFIG_HAVE_CXX=y
CONFIG_HAVE_CXXINITIALIZE=y
CONFIG_IDLETHREAD_STACKSIZE=1024
CONFIG_INIT_ENTRYPOINT="nsh_main"
CONFIG_INIT_STACKSIZE=3194
CONFIG_IOB_NBUFFERS=24
CONFIG_IOB_NCHAINS=24
CONFIG_LIBC_FLOATINGPOINT=y
CONFIG_LIBC_LONG_LONG=y
CONFIG_LIBC_MAX_EXITFUNS=1
CONFIG_LIBC_STRERROR=y
CONFIG_LIBC_STRERROR_SHORT=y
CONFIG_LIBM_TOOLCHAIN=y
CONFIG_LINE_MAX=128
CONFIG_MEMSET_64BIT=y
CONFIG_MEMSET_OPTSPEED=y
CONFIG_MM_IOB=y
CONFIG_MM_REGIONS=1
CONFIG_MX8MP_RPMSG=y
CONFIG_MX8MP_UART4=y
CONFIG_NAME_MAX=40
CONFIG_NSH_ARCHINIT=y
CONFIG_NSH_ARGCAT=y
CONFIG_NSH_BUILTIN_APPS=y
CONFIG_NSH_CMDPARMS=y
CONFIG_NSH_MAXARGUMENTS=15
CONFIG_NSH_NESTDEPTH=8
CONFIG_NSH_QUOTE=y
CONFIG_NSH_STRERROR=y
CONFIG_NSH_VARS=y
CONFIG_PIPES=y
CONFIG_PREALLOC_TIMERS=50
CONFIG_PRIORITY_INHERITANCE=y
CONFIG_PTHREAD_MUTEX_ROBUST=y
CONFIG_PTHREAD_MUTEX_TYPES=y
CONFIG_PTHREAD_STACK_MIN=512
CONFIG_RAM_SIZE=8388608
CONFIG_RAM_START=0x80800000
CONFIG_RAW_BINARY=y
CONFIG_READLINE_CMD_HISTORY=y
CONFIG_READLINE_TABCOMPLETION=y
CONFIG_RPTUN=y
CONFIG_SCHED_HPWORK=y
CONFIG_SCHED_HPWORKPRIORITY=249
CONFIG_SCHED_HPWORKSTACKSIZE=1280
CONFIG_SCHED_INSTRUMENTATION=y
CONFIG_SCHED_INSTRUMENTATION_EXTERNAL=y
CONFIG_SCHED_INSTRUMENTATION_SWITCH=y
CONFIG_SCHED_LPWORK=y
CONFIG_SCHED_LPWORKPRIORITY=50
CONFIG_SCHED_LPWORKSTACKSIZE=1632
CONFIG_SCHED_WAITPID=y
CONFIG_SEM_PREALLOCHOLDERS=32
CONFIG_SERIAL_TERMIOS=y
CONFIG_SIG_DEFAULT=y
CONFIG_SIG_SIGALRM_ACTION=y
CONFIG_SIG_SIGUSR1_ACTION=y
CONFIG_SIG_SIGUSR2_ACTION=y
CONFIG_SIG_SIGWORK=4
CONFIG_STACK_COLORATION=y
CONFIG_START_DAY=22
CONFIG_START_MONTH=11
CONFIG_STDIO_BUFFER_SIZE=256
CONFIG_SYSTEM_NSH=y
CONFIG_TASK_NAME_SIZE=24
CONFIG_UART4_BAUD=115200
CONFIG_UART4_RXBUFSIZE=600
CONFIG_UART4_SERIAL_CONSOLE=y
CONFIG_UART4_TXBUFSIZE=1500
CONFIG_USEC_PER_TICK=1000
CONFIG_WQUEUE_NOTIFIER=y
```
